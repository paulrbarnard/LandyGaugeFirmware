## main/Kconfig.projbuild
```kconfig
menu "Example Configuration"

    # Touch controller is auto-detected at runtime - no configuration needed
    # If CST820 touch controller is present, touch input is enabled
    # Button input is always available

    config BUTTON_NEXT_GPIO
        int "Next Gauge Button GPIO"
        default 0
        help
            GPIO pin number for the "Next Gauge" button.
            Works on both touch and non-touch versions.
            Button should pull low when pressed (active low with internal pull-up).

    config BUTTON_DEBOUNCE_MS
        int "Button Debounce Time (ms)"
        default 50
        range 10 200
        help
            Debounce time for physical button in milliseconds.

    config EXAMPLE_DOUBLE_FB
        bool "Use double Frame Buffer (RGB panel internal buffers)"
        default "n"
        help
            Enable this option, driver will use the RGB LCD panel's internal frame buffers.
            This provides best performance but uses the panel's limited memory.

    config LVGL_PSRAM_DOUBLE_BUFFER
        depends on !EXAMPLE_DOUBLE_FB
        bool "Use PSRAM double buffering (full screen buffers)"
        default "y"
        help
            Enable this option to allocate two full-screen buffers in PSRAM for double buffering.
            This provides smooth rendering with less tearing but uses more PSRAM (~1.6MB for 480x480 RGB565).
            Disable for lower PSRAM usage (uses smaller partial buffers instead).

    config EXAMPLE_USE_BOUNCE_BUFFER
        depends on !EXAMPLE_DOUBLE_FB
        bool "Use bounce buffer"
        help
            Enable bounce buffer mode can achieve higher PCLK frequency at the cost of higher CPU consumption.

    config EXAMPLE_AVOID_TEAR_EFFECT_WITH_SEM
        depends on !EXAMPLE_DOUBLE_FB && !LVGL_PSRAM_DOUBLE_BUFFER
        bool "Avoid tearing effect"
        default "n"
        help
            Enable this option, the example will use a pair of semaphores to avoid the tearing effect.
            Note, if Double Frame Buffer or PSRAM double buffering is used, this is not needed.

            
    config LV_USE_DEMO_WIDGETS
        bool "Show some widget"
        default y
        
    config LV_DEMO_WIDGETS_SLIDESHOW
        bool "Enable slide show"
        depends on LV_USE_DEMO_WIDGETS
        default y

    config LV_USE_DEMO_KEYPAD_AND_ENCODER
        bool "Demonstrate the usage of encoder and keyboard"
        default y

    config LV_USE_DEMO_BENCHMARK
        bool "Benchmark your system"
        default y

    config LV_USE_DEMO_STRESS
        bool "Stress test for LVGL"
        default y

    config LV_USE_DEMO_MUSIC
        bool "Music player demo"
        default y

    
    config LV_FONT_MONTSERRAT_12
        bool "Enable Montserrat 12"
        default y if !LV_CONF_MINIMAL

    config LV_FONT_MONTSERRAT_14
        bool "Enable Montserrat 14"
        default y if !LV_CONF_MINIMAL

    config LV_FONT_MONTSERRAT_16
        bool "Enable Montserrat 16"
        default y if !LV_CONF_MINIMAL

    config LV_FONT_MONTSERRAT_32
        bool "Enable Montserrat 32"
        default y if !LV_CONF_MINIMAL
        


    config BT_ENABLED
        bool "Select this option to enable Bluetooth"
        default y 

    config BT_BLE_50_FEATURES_SUPPORTED
        bool "Enabling this option activates BLE 5.0 features"
        default y 
        
    config BT_BLE_42_FEATURES_SUPPORTED
        bool "This enables BLE 4.2 features."
        default y 
endmenu

 
```
